## components/am2315c/Kconfig
```kconfig
menu "AM2315C"

config AM2315C_0_ENABLE
    int "Habilitar instancia 0 (0=no, 1=sí)"
    default 1
    range 0 1

if AM2315C_0_ENABLE = 1
config AM2315C_0_ID
    int "Identificador"
    default 20
config AM2315C_0_ADDR
    hex "Dirección I2C"
    default 0x38
config AM2315C_0_PERIOD_MS
    int "Periodo de muestreo en ms"
    default 60000
    range 1000 360000
endif

config AM2315C_1_ENABLE
    int "Habilitar instancia 1 (0=no, 1=sí)"
    default 0
    range 0 1

if AM2315C_1_ENABLE = 1
config AM2315C_1_ID
    int "Identificador"
    default 21
config AM2315C_1_ADDR
    hex "Dirección I2C"
    default 0x39
config AM2315C_1_PERIOD_MS
    int "Periodo de muestreo en ms"
    default 60000
    range 1000 360000
endif

endmenu
```

## components/veml7700/Kconfig
```kconfig
menu "VEML7700"

config VEML7700_0_ENABLE
    int "Habilitar instancia 0 (0=no, 1=sí)"
    default 1
    range 0 1

if VEML7700_0_ENABLE = 1
config VEML7700_0_ID
    int "Identificador"
    default 10
config VEML7700_0_ADDR
    hex "Dirección I2C"
    default 0x10
config VEML7700_0_PERIOD_MS
    int "Periodo de muestreo en ms"
    default 60000
    range 1000 360000
endif

config VEML7700_1_ENABLE
    int "Habilitar instancia 1 (0=no, 1=sí)"
    default 0
    range 0 1

if VEML7700_1_ENABLE = 1
config VEML7700_1_ID
    int "Identificador"
    default 11
config VEML7700_1_ADDR
    hex "Dirección I2C"
    default 0x11
config VEML7700_1_PERIOD_MS
    int "Periodo de muestreo en ms"
    default 60000
    range 1000 360000
endif

endmenu
```

## main/Kconfig
```kconfig
menu "Brote nodo"

config NODE_ID
    int "Identificador del nodo"
    default 0

config NODE_NAME
    string "Nombre del nodo"
    default "Terraza"


config NODE_IP
    string "IP del nodo"
    default "172.20.10.200"
    #default "192.168.1.100"

config NODE_GW
    string "Gateway de la red"
    default "172.20.10.1"
    #default "192.168.1.1"

config NODE_SUBMASK
    string "Mascara de subred"
    default "255.255.255.0"

config NODE_DST_IP
    string "IP destino"
    default "172.20.10.4"
    #default "192.168.1.148"
    #default "192.168.1.134"

config NODE_DATA_PORT
    int "Puerto destino de datos"
    default 12345

config NODE_LOG_PORT
    int "Puerto destino de logs"
    default 54321

config NODE_LISTEN_PORT
    int "Puerto de escucha"
    default 35353

endmenu
```
